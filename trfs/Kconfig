## trfs/Kconfig
```kconfig
config TRFS_FS
	tristate "Trfs stackable file system (EXPERIMENTAL)"
	help
	  Trfs is a stackable file system which simply passes its
	  operations to the lower layer.  It is designed as a useful
	  template for developing or debugging other stackable file systems,
	  and more (see Documentation/filesystems/trfs.txt).  See
	  <http://trfs.filesystems.org/> for details.
```
